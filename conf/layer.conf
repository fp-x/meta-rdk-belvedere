## conf/layer.conf
```bitbake
BBPATH .= ":${LAYERDIR}"

BBFILES += "\
            ${LAYERDIR}/recipes-*/*/*.bb \
            ${LAYERDIR}/recipes-*/*/*.bbappend \
           "

BBFILE_COLLECTIONS += "ccsp"
BBFILE_PATTERN_ccsp := "^${LAYERDIR}/"
BBFILE_PRIORITY_ccsp = "7"

# Additional license directories.
LICENSE_PATH += "${LAYERDIR}/licenses"

RDKB_CCSP_ROOT_GIT ?= "git://github.com/belvedere-yocto"
RDK_GIT_PROTOCOL ?= "https"
CCSP_GIT_BRANCH ?= "latest"
#CCSP_EXT ?= "/generic"
CCSP_EXT ?= ".git"
RDK_RELEASE ?= "1.99"
```
